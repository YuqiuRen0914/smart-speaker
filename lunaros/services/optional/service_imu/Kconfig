## lunaros/services/required/service_ota/Kconfig
```kconfig
menu "Lunaredu OTA"

config LUNAREDU_OTA_DUAL_SLOT_LAYOUT
    bool "Use explicit dual 6 MiB business slots (16 MiB v2)"
    default n
    depends on (IDF_TARGET_ESP32S3 || IDF_TARGET_ESP32S31) && BOOTLOADER_APP_ROLLBACK_ENABLE && !LUNAREDU_OTA_RECOVERY_LAYOUT
    help
        Requires the exact lunaros-16m-v2 table and a board-matched business
        image declaration. This selects an installation policy, not a runtime
        partition migration. Existing unselected profiles keep their policy.

config LUNAREDU_OTA_RECOVERY_LAYOUT
    bool "Use permanent recovery with one business partition (16 MiB v3)"
    default n
    depends on (IDF_TARGET_ESP32S3 || IDF_TARGET_ESP32S31) && BOOTLOADER_APP_ROLLBACK_ENABLE && !BOOTLOADER_APP_ANTI_ROLLBACK
    help
        Requires the exact lunaros-16m-v3-recovery partition layout. Only
        recovery may install a v3 business image; business must hand off first.
        Existing v2 builds retain their original writer and boot behavior.

config LUNAREDU_OTA_RECOVERY_IMAGE
    bool "This image is the permanent factory recovery application"
    depends on LUNAREDU_OTA_RECOVERY_LAYOUT
    default n

config LUNAREDU_OTA_RECOVERY_HARDWARE
    string "Compatible deployment hardware identity"
    depends on LUNAREDU_OTA_RECOVERY_LAYOUT || LUNAREDU_OTA_DUAL_SLOT_LAYOUT
    default "remote-control-controller"

config LUNAREDU_SYSTEM_OTA_BOOT_CONFIRM_TIMEOUT_MS
    int "OTA boot confirmation timeout (ms)"
    depends on BOOTLOADER_APP_ROLLBACK_ENABLE
    default 120000
    range 5000 300000
    help
        Maximum time a newly booted OTA image may remain pending verification.
        The framework boot-health gate confirms the image after critical
        tasks and recovery services are healthy. If health is not reached,
        LunarOS marks the image invalid and boots the previous image.
        The default covers the shared 60-second Wi-Fi provisioning fallback
        plus service startup and the continuous boot-health confirmation.

endmenu

config LUNAREDU_OTA_FIELD_DIAGNOSTICS_LAYOUT
    bool "Field diagnostics partition layout"
    depends on LUNAREDU_OTA_RECOVERY_LAYOUT
    default n
    help
        Selects the explicit v4 recovery/business layout with a 512 KiB encrypted Core Dump partition.
```

## lunaros/services/required/service_storage/Kconfig
```kconfig
menu "LunarOS Storage"

config LUNAREDU_STORAGE_POOL_USER_RESERVE_KIB
    int "Default managed-pool user reserve (KiB, 0 uses layout default)"
    default 0
    range 0 16384
    help
        Product deployment profiles may select a smaller or larger default
        reserve to fit their factory assets. Valid saved user preferences take
        precedence. Zero preserves the existing layout defaults (512 KiB for
        standard/recovery, 64 KiB for S31 vision). Free-space headroom and
        actual-volume admission checks remain enforced.

endmenu
```

## lunaros/services/required/service_storage/Kconfig.projbuild
```kconfig
choice LITTLEFS_MALLOC_STRATEGY
    default LITTLEFS_MALLOC_STRATEGY_SPIRAM_PREFER if SPIRAM_USE_MALLOC
endchoice
```

## lunaros/services/required/service_usb/Kconfig
```kconfig
menu "LunarOS USB"
config LUNAROS_USB_HOST_CDC
    bool "Enable native USB CDC Host backend"
    depends on IDF_TARGET_ESP32S3
    default n
    help
        Opt-in backend selected with app_programmer. Requires usb_host_cdc_acm.
        USB Serial/JTAG consoles must be disabled before taking the internal PHY.
config LUNAROS_USB_DEVICE_LOG_OUTPUT
    bool "Route normal logs through the USB Device service"
    depends on LUNAROS_USB_HOST_CDC && ESP_CONSOLE_NONE
    default n
    help
        Device-mode logs use bounded, zero-wait Serial/JTAG output. Closing the
        service disables this writer before Host takes the PHY. Stdout and ROM
        output stay disabled, so neither can access a retired Device driver.
endmenu
```

## lunaros_apps/lunaredu_pet/Kconfig.projbuild
```kconfig
menu "Assistant platform"
choice LUNAREDU_ASSISTANT_PLATFORM
    prompt "Assistant cloud protocol"
    default LUNAREDU_ASSISTANT_XIAOZHI
config LUNAREDU_ASSISTANT_XIAOZHI
    bool "XiaoZhi official platform"
config LUNAREDU_ASSISTANT_LUNARLINK
    bool "LunarLink (Board account required)"
config LUNAREDU_ASSISTANT_MAC
    bool "Mac companion (local SenseVoice / DeepSeek / Feiyu)"
endchoice
config LUNAREDU_ASSISTANT_MAC_URL
    string "Mac bootstrap URL (trusted LAN only)"
    depends on LUNAREDU_ASSISTANT_MAC
    default "http://speaker-mac.local:8765/xiaozhi/ota/"
config LUNAREDU_ASSISTANT_MAC_TOKEN
    string "Mac bootstrap shared token (keep sdkconfig private)"
    depends on LUNAREDU_ASSISTANT_MAC
    default ""
endmenu
```

## main/Kconfig.projbuild
```kconfig
menu "Smart Speaker"

config LUNAREDU_SMART_SPEAKER_WIFI_PROVISION_TIMEOUT_MS
    int "Wi-Fi provision timeout in ms"
    range 1000 60000
    default 5000

config LUNAREDU_SMART_SPEAKER_NETWORK_TASK_STACK_SIZE
    int "Network task stack size in bytes"
    range 4096 32768
    default 12288

config LUNAREDU_SMART_SPEAKER_PLAYER_TASK_STACK_SIZE
    int "Player task stack size in bytes"
    range 4096 32768
    default 12288

config LUNAREDU_SMART_SPEAKER_ENCODER_A_GPIO
    int "Rotary encoder A GPIO"
    range 0 48
    default 12

config LUNAREDU_SMART_SPEAKER_ENCODER_B_GPIO
    int "Rotary encoder B GPIO"
    range 0 48
    default 11

config LUNAREDU_SMART_SPEAKER_ENCODER_REVERSED
    bool "Reverse encoder direction"
    default y

config LUNAREDU_SMART_SPEAKER_LEFT_BUTTON_GPIO
    int "Previous/left button GPIO"
    range 0 48
    default 8

config LUNAREDU_SMART_SPEAKER_RIGHT_BUTTON_GPIO
    int "Next/right button GPIO"
    range 0 48
    default 7

config LUNAREDU_SMART_SPEAKER_BUTTON_ACTIVE_LOW
    bool "Buttons are active low"
    default y

config LUNAREDU_SMART_SPEAKER_LEFT_I2S_WS
    int "Left MAX98357 WS GPIO"
    range 0 48
    default 6

config LUNAREDU_SMART_SPEAKER_LEFT_I2S_BCLK
    int "Left MAX98357 BCLK GPIO"
    range 0 48
    default 7

config LUNAREDU_SMART_SPEAKER_LEFT_I2S_DOUT
    int "Left MAX98357 DIN GPIO"
    range 0 48
    default 16

config LUNAREDU_SMART_SPEAKER_RIGHT_I2S_WS
    int "Right MAX98357 WS GPIO"
    range 0 48
    default 8

config LUNAREDU_SMART_SPEAKER_RIGHT_I2S_BCLK
    int "Right MAX98357 BCLK GPIO"
    range 0 48
    default 10

config LUNAREDU_SMART_SPEAKER_RIGHT_I2S_DOUT
    int "Right MAX98357 DIN GPIO"
    range 0 48
    default 5

config LUNAREDU_SMART_SPEAKER_TOUCH_SDA_GPIO
    int "Touch controller SDA GPIO"
    range 0 48
    default 43

config LUNAREDU_SMART_SPEAKER_TOUCH_SCL_GPIO
    int "Touch controller SCL GPIO"
    range 0 48
    default 44

config LUNAREDU_SMART_SPEAKER_TOUCH_INT_GPIO
    int "Touch controller INT GPIO"
    range -1 48
    default 48

config LUNAREDU_SMART_SPEAKER_MPU6050_SDA_GPIO
    int "MPU6050 SDA GPIO"
    range 0 48
    default 41

config LUNAREDU_SMART_SPEAKER_MPU6050_SCL_GPIO
    int "MPU6050 SCL GPIO"
    range 0 48
    default 42

config LUNAREDU_SMART_SPEAKER_VOLUME_STEP
    int "Volume step per encoder detent"
    range 1 20
    default 5

config LUNAREDU_SMART_SPEAKER_FADE_MS
    int "Pop-suppression fade time in ms"
    range 20 80
    default 40

config LUNAREDU_SMART_SPEAKER_MAX_VOLUME
    int "Maximum output volume percent"
    range 1 70
    default 70

config LUNAREDU_SMART_SPEAKER_STARTUP_VOLUME
    int "Safe startup volume percent"
    range 0 20
    default 10
    help
        Volume selected after every reset. Keep this deliberately below the
        normal maximum so a marginal amplifier supply cannot enter a
        reset/playback loop before the user can intervene.

config LUNAREDU_SMART_SPEAKER_AUTOPLAY_ON_BOOT
    bool "Automatically start SD playback after boot"
    default n
    help
        Disabled by default for amplifier bring-up safety. I2S clocks remain
        active with zero samples and playback starts only after an explicit
        local or web play command.

config LUNAREDU_SMART_SPEAKER_DEVELOPMENT_PLATFORM
    bool "Use local platform for development"
    default n
    help
        Explicit development build: persist the development environment and
        restart once before using the local platform. Leave disabled for releases.

config LUNAREDU_SMART_SPEAKER_DEVELOPMENT_PLATFORM_URL
    string "Local Tools platform base URL"
    depends on LUNAREDU_SMART_SPEAKER_DEVELOPMENT_PLATFORM
    default ""
    help
        Use the Tools domain of the developer gateway on a reachable private IP.

endmenu
```

## sdkconfig.defaults
```kconfig
CONFIG_IDF_TARGET="esp32s3"
CONFIG_IDF_TARGET_ESP32S3=y

CONFIG_LUNAREDU_BSP_PROFILE_CAM_BUNDLE=y

CONFIG_ESPTOOLPY_FLASHMODE_QIO=y
CONFIG_ESPTOOLPY_FLASHFREQ_80M=y
CONFIG_ESPTOOLPY_MONITOR_BAUD=115200

CONFIG_ESP_CONSOLE_USB_SERIAL_JTAG=y
CONFIG_ESP_CONSOLE_SECONDARY_NONE=y


CONFIG_SPIRAM=y
CONFIG_SPIRAM_ALLOW_BSS_SEG_EXTERNAL_MEMORY=y
CONFIG_SPIRAM_MODE_OCT=y
CONFIG_SPIRAM_SPEED_80M=y
CONFIG_SPIRAM_USE_MALLOC=y
# Keep DMA-capable SRAM available for SDMMC bounce buffers while Wi-Fi, LCD,
# and both I2S controllers are active. MP3 refills can be unaligned, so the
# SDMMC driver must always be able to allocate at least one temporary sector.
CONFIG_SPIRAM_MALLOC_RESERVE_INTERNAL=102400
CONFIG_FREERTOS_TASK_CREATE_ALLOW_EXT_MEM=y
CONFIG_MQTT_BUFFERS_ON_EXTERNAL_MEMORY=y
CONFIG_MQTT_TASK_STACK_ON_EXTERNAL_MEMORY=y
CONFIG_FREERTOS_HZ=1000
CONFIG_GPIO_CTRL_FUNC_IN_IRAM=y
CONFIG_ESP_INT_WDT_TIMEOUT_MS=1000
CONFIG_ESP_WIFI_TASK_PINNED_TO_CORE_1=y
CONFIG_LWIP_TCPIP_TASK_AFFINITY_CPU1=y


CONFIG_LITTLEFS_OBJ_NAME_LEN=64
CONFIG_LITTLEFS_READ_SIZE=128
CONFIG_LITTLEFS_WRITE_SIZE=128
CONFIG_LITTLEFS_PAGE_SIZE=256
CONFIG_LITTLEFS_CACHE_SIZE=512
CONFIG_LITTLEFS_USE_MTIME=y

CONFIG_AUDIO_PLAYER_ENABLE_MP3=y
# CONFIG_AUDIO_PLAYER_ENABLE_WAV is not set
CONFIG_AUDIO_PLAYER_LOG_LEVEL=1

# Build the generic helpers used by this product app. Camera stays disabled
# even though the cam-bundle BSP profile is selected for the TF-card pins.
CONFIG_LUNAREDU_DEVICE_ENABLE_AUDIO=y
CONFIG_LUNAREDU_DEVICE_ENABLE_TFCARD=y
CONFIG_LUNAREDU_DEVICE_I2S_AUDIO=y
# CONFIG_LUNAREDU_DEVICE_I2S_AUDIO_DUPLEX is not set
CONFIG_LUNAREDU_DEVICE_I2S_AUDIO_SIMPLEX=y
CONFIG_LUNAREDU_DEVICE_I2S_AUDIO_OUTPUT_SAMPLE_RATE=44100
CONFIG_LUNAREDU_DEVICE_I2S_AUDIO_INPUT_SAMPLE_RATE=44100
CONFIG_LUNAREDU_DEVICE_I2S_AUDIO_SPK_BCLK=47
CONFIG_LUNAREDU_DEVICE_I2S_AUDIO_SPK_WS=14
CONFIG_LUNAREDU_DEVICE_I2S_AUDIO_SPK_DOUT=1
CONFIG_LUNAREDU_DEVICE_I2S_AUDIO_MIC_SCK=47
CONFIG_LUNAREDU_DEVICE_I2S_AUDIO_MIC_WS=14
CONFIG_LUNAREDU_DEVICE_I2S_AUDIO_MIC_DIN=21
CONFIG_LUNAREDU_DEVICE_INPUT_PRIMARY_BUTTON=y
CONFIG_LUNAREDU_DEVICE_INPUT_PRIMARY_BUTTON_GPIO=8
CONFIG_LUNAREDU_DEVICE_INPUT_PRIMARY_BUTTON_ACTIVE_HIGH=n
CONFIG_LUNAREDU_DEVICE_INPUT_PRIMARY_BUTTON_LONG_PRESS_MS=2000
CONFIG_LUNAREDU_DEVICE_INPUT_PRIMARY_BUTTON_SHORT_PRESS_MS=0
CONFIG_LUNAREDU_DEVICE_INPUT_PTT_BUTTON=y
CONFIG_LUNAREDU_DEVICE_INPUT_PTT_BUTTON_GPIO=7
CONFIG_LUNAREDU_DEVICE_INPUT_PTT_BUTTON_ACTIVE_HIGH=n

CONFIG_LUNAREDU_SMART_SPEAKER_WIFI_PROVISION_TIMEOUT_MS=5000
CONFIG_LUNAREDU_SMART_SPEAKER_NETWORK_TASK_STACK_SIZE=12288
CONFIG_LUNAREDU_SMART_SPEAKER_PLAYER_TASK_STACK_SIZE=12288
CONFIG_LUNAREDU_SMART_SPEAKER_ENCODER_A_GPIO=12
CONFIG_LUNAREDU_SMART_SPEAKER_ENCODER_B_GPIO=11
CONFIG_LUNAREDU_SMART_SPEAKER_ENCODER_REVERSED=y
CONFIG_LUNAREDU_SMART_SPEAKER_LEFT_BUTTON_GPIO=8
CONFIG_LUNAREDU_SMART_SPEAKER_RIGHT_BUTTON_GPIO=7
CONFIG_LUNAREDU_SMART_SPEAKER_BUTTON_ACTIVE_LOW=y
CONFIG_LUNAREDU_SMART_SPEAKER_LEFT_I2S_WS=14
CONFIG_LUNAREDU_SMART_SPEAKER_LEFT_I2S_BCLK=47
CONFIG_LUNAREDU_SMART_SPEAKER_LEFT_I2S_DOUT=1
CONFIG_LUNAREDU_SMART_SPEAKER_MIC_I2S_DIN=21
CONFIG_LUNAREDU_SMART_SPEAKER_RIGHT_I2S_WS=17
CONFIG_LUNAREDU_SMART_SPEAKER_RIGHT_I2S_BCLK=16
CONFIG_LUNAREDU_SMART_SPEAKER_RIGHT_I2S_DOUT=15
CONFIG_LUNAREDU_SMART_SPEAKER_VOLUME_STEP=5
CONFIG_LUNAREDU_SMART_SPEAKER_FADE_MS=40
CONFIG_LUNAREDU_SMART_SPEAKER_MAX_VOLUME=70
CONFIG_LUNAREDU_SMART_SPEAKER_STARTUP_VOLUME=10
# CONFIG_LUNAREDU_SMART_SPEAKER_AUTOPLAY_ON_BOOT is not set

CONFIG_LUNAREDU_DEVICE_DISPLAY_SPI_LCD=y
CONFIG_LUNAREDU_DEVICE_DISPLAY_SPI_LCD_ST7789=y
CONFIG_LUNAREDU_DEVICE_DISPLAY_SPI_LCD_SPI2_HOST=y
# CONFIG_LUNAREDU_DEVICE_DISPLAY_SPI_LCD_SPI3_HOST is not set
CONFIG_LUNAREDU_DEVICE_DISPLAY_SPI_LCD_MOSI=45
CONFIG_LUNAREDU_DEVICE_DISPLAY_SPI_LCD_SCLK=3
CONFIG_LUNAREDU_DEVICE_DISPLAY_SPI_LCD_MISO=-1
CONFIG_LUNAREDU_DEVICE_DISPLAY_SPI_LCD_CS=0
CONFIG_LUNAREDU_DEVICE_DISPLAY_SPI_LCD_DC=46
CONFIG_LUNAREDU_DEVICE_DISPLAY_SPI_LCD_RESET=-1
CONFIG_LUNAREDU_DEVICE_DISPLAY_SPI_LCD_BACKLIGHT=-1
CONFIG_LUNAREDU_DEVICE_DISPLAY_SPI_LCD_PIXEL_CLOCK_HZ=40000000
CONFIG_LUNAREDU_DEVICE_DISPLAY_SPI_LCD_SPI_MODE=0
CONFIG_LUNAREDU_DEVICE_DISPLAY_SPI_LCD_WIDTH=240
CONFIG_LUNAREDU_DEVICE_DISPLAY_SPI_LCD_HEIGHT=240
CONFIG_LUNAREDU_DEVICE_DISPLAY_SPI_LCD_OFFSET_X=0
CONFIG_LUNAREDU_DEVICE_DISPLAY_SPI_LCD_OFFSET_Y=0
# CONFIG_LUNAREDU_DEVICE_DISPLAY_SPI_LCD_MIRROR_X is not set
# CONFIG_LUNAREDU_DEVICE_DISPLAY_SPI_LCD_MIRROR_Y is not set
# CONFIG_LUNAREDU_DEVICE_DISPLAY_SPI_LCD_SWAP_XY is not set
CONFIG_LUNAREDU_DEVICE_DISPLAY_SPI_LCD_INVERT_COLOR=y
CONFIG_LUNAREDU_DEVICE_DISPLAY_SPI_LCD_RGB_ORDER_RGB=y
# CONFIG_LUNAREDU_DEVICE_DISPLAY_SPI_LCD_RGB_ORDER_BGR is not set
# CONFIG_LUNAREDU_DEVICE_DISPLAY_SPI_LCD_CLAIM_BSP_SPI is not set
CONFIG_LUNAREDU_DESKTOP_LVGL_RUNTIME=y
CONFIG_LV_FONT_MONTSERRAT_36=y
CONFIG_LUNAREDU_DESKTOP_SHARED_FONTS=y
# Chinese UI uses the shared Lunar Sans SC TTF asset through TinyTTF.
# CONFIG_LV_FONT_SOURCE_HAN_SANS_SC_16_CJK is not set

CONFIG_LUNAREDU_DEVICE_ENABLE_MPU6050=y

CONFIG_LUNAREDU_SYSTEM_OTA_BOOT_CONFIRM_TIMEOUT_MS=120000
CONFIG_SPIRAM_MALLOC_ALWAYSINTERNAL=1024
CONFIG_SPIRAM_TRY_ALLOCATE_WIFI_LWIP=y
CONFIG_LUNAREDU_LUNAROS_MAX_INTERNAL_TASK_STACK_BYTES=98304
CONFIG_ESP_MAIN_TASK_STACK_SIZE=8192
# CONFIG_MBEDTLS_INTERNAL_MEM_ALLOC is not set
CONFIG_MBEDTLS_EXTERNAL_MEM_ALLOC=y
CONFIG_MBEDTLS_DYNAMIC_BUFFER=y
CONFIG_MBEDTLS_DYNAMIC_FREE_CONFIG_DATA=y
CONFIG_MBEDTLS_DYNAMIC_FREE_CA_CERT=y
# CONFIG_MBEDTLS_HARDWARE_AES is not set

CONFIG_LV_USE_TINY_TTF=y

CONFIG_LV_MEM_SIZE_KILOBYTES=256

# Read-only CPU idle/task counters for performance diagnosis; no extra task.
# Optimize shared LCD/LVGL/network code as well as the product's hot loops.
CONFIG_COMPILER_OPTIMIZATION_PERF=y
CONFIG_ESP_DEFAULT_CPU_FREQ_MHZ_240=y
CONFIG_FREERTOS_GENERATE_RUN_TIME_STATS=y
CONFIG_FREERTOS_RUN_TIME_COUNTER_TYPE_U64=y
CONFIG_FREERTOS_RUN_TIME_STATS_USING_ESP_TIMER=y

# Shared LunarOS 16 MiB flash contract.

# Universal 16 MiB hardware and recoverable delivery contract.
CONFIG_ESPTOOLPY_FLASHSIZE_16MB=y
CONFIG_ESPTOOLPY_FLASHSIZE="16MB"
CONFIG_PARTITION_TABLE_CUSTOM=y
CONFIG_PARTITION_TABLE_CUSTOM_FILENAME="partitions/lunaros-16m-v2.csv"
CONFIG_PARTITION_TABLE_FILENAME="partitions/lunaros-16m-v2.csv"
CONFIG_PARTITION_TABLE_OFFSET=0x10000
CONFIG_BOOTLOADER_APP_ROLLBACK_ENABLE=y
CONFIG_LUNAREDU_NETWORK_ENABLE_PROVISIONING_SERVICE=y
CONFIG_LUNAREDU_DEVICE_WEB=y
```
