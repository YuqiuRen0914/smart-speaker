## lunaros/services/optional/service_imu/Kconfig
```kconfig
menu "IMU service optional processing"
config LUNAROS_IMU_FUSION
    bool "Enable optional six/nine-axis fusion and magnetic proximity processing"
    default n
    help
        Compile the independent portable fusion module and optional IMU service
        adapter. A product must explicitly configure the adapter before starting
        the service. No sensor, bus, product, or worker is selected automatically.
        Magnetic anomalies immediately disable magnetic heading feedback;
        stable fresh observations are required for gradual recovery.
endmenu
```

## lunaros/services/optional/service_provisioning/Kconfig
```kconfig
menu "LunarOS provisioning function"
config LUNAROS_PROVISIONING
    bool "Enable assisted network provisioning"
    select ESP_PROTOCOMM_SUPPORT_SECURITY_VERSION_1
    default y
    help
        Own temporary setup windows and client confirmation independently of
        Settings, USB, Network and Pet. Uses the existing network executor.
endmenu
```

## lunaros/services/optional/service_python/Kconfig
```kconfig
menu "LunarEdu MicroPython"

config LUNAREDU_MICROPYTHON_HEAP_BYTES
    int "MicroPython heap size"
    default 65536
    range 16384 524288
    help
        Heap size in bytes passed to the embedded MicroPython VM.

config LUNAREDU_MICROPYTHON_MAX_UPLOAD_PAYLOAD_BYTES
    int "Maximum script upload payload"
    default 12288
    range 1024 262144
    help
        Maximum accepted script upload body size in bytes.

config LUNAREDU_MICROPYTHON_MAX_LOGS
    int "MicroPython log ring entries"
    default 64
    range 1 255
    help
        Number of stdout/runtime log entries retained in memory.

config LUNAREDU_MICROPYTHON_TICK_INTERVAL_MS
    int "MicroPython owner tick interval"
    default 10
    range 1 1000
    help
        Tick interval reported in MicroPython capability metadata.

config LUNAREDU_MICROPYTHON_TASK_STACK_BYTES
    int "MicroPython owner task stack size"
    default 12288
    range 8192 32768
    help
        Stack size in bytes for the single FreeRTOS task that owns the VM.

config LUNAREDU_MICROPYTHON_TASK_PRIORITY
    int "MicroPython owner task priority"
    default 1
    range 1 20
    help
        FreeRTOS priority for the MicroPython VM owner task.

config LUNAREDU_MICROPYTHON_COMMAND_QUEUE_DEPTH
    int "MicroPython command queue depth"
    default 8
    range 2 32
    help
        Number of pending script or REPL commands accepted by the VM task.

config LUNAREDU_MICROPYTHON_ENABLE_HARDWARE_BINDINGS
    bool "Enable LunarEdu hardware native module"
    default n
    help
        Build the optional Python-side lunaredu native module and bind it to
        LunarEdu device and system capabilities. Leave this disabled
        for firmware that only needs the base MicroPython VM.

config LUNAREDU_MICROPYTHON_ENABLE_RGB_BINDING
    bool "Expose WS2812 APIs"
    depends on LUNAREDU_MICROPYTHON_ENABLE_HARDWARE_BINDINGS
    default n

config LUNAREDU_MICROPYTHON_ENABLE_IMU_BINDING
    bool "Expose MPU6050 APIs"
    depends on LUNAREDU_MICROPYTHON_ENABLE_HARDWARE_BINDINGS
    default n

config LUNAREDU_MICROPYTHON_ENABLE_CAMERA_BINDING
    bool "Expose camera APIs"
    depends on LUNAREDU_MICROPYTHON_ENABLE_HARDWARE_BINDINGS
    default n

config LUNAREDU_MICROPYTHON_ENABLE_TFCARD_BINDING
    bool "Expose TF card APIs"
    depends on LUNAREDU_MICROPYTHON_ENABLE_HARDWARE_BINDINGS
    default n

config LUNAREDU_MICROPYTHON_ENABLE_SERVO_BINDING
    bool "Expose servo APIs"
    depends on LUNAREDU_MICROPYTHON_ENABLE_HARDWARE_BINDINGS
    default n

config LUNAREDU_MICROPYTHON_ENABLE_ASRPRO_BINDING
    bool "Expose ASRPRO APIs"
    depends on LUNAREDU_MICROPYTHON_ENABLE_HARDWARE_BINDINGS
    default n

config LUNAREDU_MICROPYTHON_ENABLE_SCREEN_BINDING
    bool "Expose SPI LCD canvas APIs"
    depends on LUNAREDU_MICROPYTHON_ENABLE_HARDWARE_BINDINGS
    default n

config LUNAREDU_MICROPYTHON_ENABLE_VISION_BINDINGS
    bool "Expose vision APIs to the LunarEdu Python module"
    select LUNAROS_IMAGE_CODEC_ENABLE_JPEG_DECODER
    select LUNAREDU_MICROPYTHON_ENABLE_CAMERA_BINDING
    depends on LUNAREDU_MICROPYTHON_ENABLE_HARDWARE_BINDINGS
    default n
    help
        Add lunaredu.vision and the JPEG decoder to the optional hardware
        facade. A camera-backed product is required. Keep this disabled on
        products without a vision workflow so
          MicroPython does not pull the recognition application and image-codec component into
        the firmware.

config LUNAREDU_MICROPYTHON_ENABLE_LUNARLINK_BINDINGS
    bool "Expose LunarLink assistant service to the LunarEdu Python module"
    depends on LUNAREDU_MICROPYTHON_ENABLE_HARDWARE_BINDINGS
    default n
    help
        Add lunaredu.lunarlink status and lifecycle controls to the optional
        hardware facade. The LunarLink service remains a native FreeRTOS service;
        Python only receives a thin application-facing adapter.

config LUNAREDU_MICROPYTHON_ENABLE_PET_BINDINGS
    bool "Expose safe smart-pet motion APIs to the LunarEdu Python module"
    depends on LUNAREDU_MICROPYTHON_ENABLE_HARDWARE_BINDINGS
    default n
    help
        Add lunaredu.robot semantic movement helpers. Commands are validated
        and executed through Motion's OS capability as caller micropython;
        Python never owns motor GPIO or PWM. This binding does not require Pet.


config LUNAROS_ENABLE_MICROPYTHON
    bool "Enable core MicroPython script execution"
    default y
    help
        Expose the shared script upload, run, stop, REPL and log API by default.
        The VM starts on demand; enabling the API does not run user code at boot.
        Disable explicitly for products that must not execute Python scripts.
        Hardware bindings remain separately selected by the product.

endmenu
```

## lunaros/services/required/service_local_web/Kconfig
```kconfig
menu "Lunaredu Local Web"

config LUNAREDU_DEVICE_WEB
    bool "Device-hosted Web pages"
    default y
    help
        Compile embedded setup and product pages in the Local Web service.
        Its HTTP API remains available without pages; SoftAP/DNS belong to Network.

config LUNAREDU_DEVICE_WEB_MAX_PAGE_BYTES
    int "Maximum optional filesystem/product Web page bytes"
    range 4096 131072
    default 65536
    depends on LUNAREDU_DEVICE_WEB

config LUNAREDU_DEVICE_API_HTTP_SERVER_PORT
    int "Local Device API HTTP port"
    default 80
    range 1 65535

config LUNAREDU_DEVICE_API_HTTP_STACK_SIZE
    int "Local Device API HTTP task stack size"
    default 12288
    range 4096 65536

config LUNAREDU_DEVICE_API_HTTP_SERVER_CORE_ID
    int "Local Device API HTTP task core"
    default 0
    range 0 1
    help
        Keep blocking HTTP parsing and serialization with network I/O on
        core 0. Device access still uses each operation's declared executor;
        the HTTP task does not become the input or graphical owner.

config LUNAREDU_DEVICE_API_HTTP_MAX_BUFFERED_BODY_BYTES
    int "Local Device API max buffered body bytes"
    default 65536
    range 1024 1048576

config LUNAREDU_DEVICE_API_HTTP_BODY_RECEIVE_TIMEOUTS
    int "Local Device API body receive timeout retries"
    default 3
    range 0 255

endmenu
```

## lunaros/services/required/service_network/Kconfig
```kconfig
menu "LunarOS service_network"

config LUNAROS_NETWORK_REALTIME_UDP
    bool "Reserve receive capacity for real-time UDP streams"
    default n
    help
        Select bounded socket and TCP/IP mailboxes for streams with up to
        24 outstanding datagrams. This does not enable a radio or open a
        socket. Applications still own their stream pacing and lifetime.

# Shared transport implementation, not a product setting or runtime toggle.
config LUNAROS_NETWORK_TLS_SESSION_SUPPORT
    bool
    default y
    depends on ESP_TLS_USING_MBEDTLS && MBEDTLS_CLIENT_SSL_SESSION_TICKETS
    select ESP_TLS_CLIENT_SESSION_TICKETS
    select ESP_HTTP_CLIENT_ENABLE_CUSTOM_TRANSPORT

config LUNAROS_NETWORK_BLUETOOTH_PROFILES
    bool "Enable Bluetooth discovery, pairing and peripheral profiles"
    default n
    help
        Optional protocol capabilities inside Network, sharing its controller,
        host, executor and lifecycle. This does not turn on the radio.
        Classic music additionally requires an explicitly selected Audio owner.


config LUNAREDU_NETWORK_ENABLE_ESPNOW
    bool "Enable LunarOS ESP-NOW transport"
    default n
    help
        Compile ESP-NOW under the shared Network service. Products opt in
        through NetworkPolicy; Wi-Fi lifecycle remains owned by LunarOS.

config LUNAROS_NETWORK_LOCAL_ACCESS
    bool "Enable temporary local Wi-Fi access"
    default y

config LUNAROS_NETWORK_LOCAL_GATT
    bool "Enable local BLE GATT transport"
    depends on BT_NIMBLE_ENABLED
    default n
    help
        Compile the local data GATT transport. Function owners supply handlers;
        this module does not own setup, account or client confirmation state.

config LUNAREDU_NETWORK_BT_START_MIN_INTERNAL_FREE
    int "Minimum free internal DMA bytes before Bluetooth startup"
    depends on BT_BLUEDROID_ENABLED || BT_NIMBLE_ENABLED
    range 0 524288
    default 65536 if SPIRAM_USE_MALLOC && BT_BLUEDROID_ENABLED
    default 49152 if SPIRAM_USE_MALLOC && BT_NIMBLE_ENABLED
    default 0
    help
        Network admission for controller pools and host tasks. Reject
        startup before calling the SDK when this budget is unavailable.

config LUNAREDU_NETWORK_BT_START_MIN_INTERNAL_BLOCK
    int "Minimum contiguous internal DMA bytes before Bluetooth startup"
    depends on BT_BLUEDROID_ENABLED || BT_NIMBLE_ENABLED
    range 0 524288
    default 32768 if SPIRAM_USE_MALLOC && BT_BLUEDROID_ENABLED
    default 30720 if SPIRAM_USE_MALLOC && BT_NIMBLE_ENABLED
    default 0

endmenu
config LUNAROS_NETWORK_HARDWARE_AES
    bool "Use SDK hardware AES acceleration"
    default y
    help
        Network owns the SDK crypto implementation selection. A product may
        disable acceleration explicitly when validating its board memory path.
```

## lunaros/services/required/service_network/Kconfig.projbuild
```kconfig
config LUNAROS_NETWORK_ESPNOW_MANAGEMENT
    bool "Explicitly authorized ESP-NOW management sessions"
    depends on LUNAREDU_NETWORK_ENABLE_ESPNOW
    select ESP_PROTOCOMM_SUPPORT_SECURITY_VERSION_1
    default y
    help
        Official PoP security1 handshake and CCM frames on the existing Network
        owner. No automatic window: native callers must specify a single peer,
        proof of possession, allowed profiles and a live authorization gate.

config ESP_WIFI_STATIC_RX_BUFFER_NUM
    int
    depends on ESP_WIFI_ENABLED || ESP_HOST_WIFI_ENABLED
    default 8 if IDF_TARGET_ESP32S31 && SPIRAM_USE_MALLOC
    default 6 if IDF_TARGET_ESP32S3 && SPIRAM_USE_MALLOC

config ESP_WIFI_STATIC_TX_BUFFER_NUM
    int
    depends on (ESP_WIFI_ENABLED || ESP_HOST_WIFI_ENABLED) && ESP_WIFI_STATIC_TX_BUFFER
    default 6 if IDF_TARGET_ESP32S31 && SPIRAM_USE_MALLOC
    default 4 if IDF_TARGET_ESP32S3 && SPIRAM_USE_MALLOC

config ESP_WIFI_RX_BA_WIN
    int
    depends on (ESP_WIFI_ENABLED || ESP_HOST_WIFI_ENABLED) && ESP_WIFI_AMPDU_RX_ENABLED
    default 8 if IDF_TARGET_ESP32S31 && SPIRAM_USE_MALLOC
    default 6 if IDF_TARGET_ESP32S3 && SPIRAM_USE_MALLOC

config ESP_WIFI_IRAM_OPT
    bool
    depends on ESP_WIFI_ENABLED || ESP_HOST_WIFI_ENABLED
    default n if SPIRAM_USE_MALLOC

config ESP_WIFI_RX_IRAM_OPT
    bool
    depends on ESP_WIFI_ENABLED || ESP_HOST_WIFI_ENABLED
    default n if SPIRAM_USE_MALLOC

choice MBEDTLS_MEM_ALLOC_MODE
    default MBEDTLS_EXTERNAL_MEM_ALLOC if SPIRAM_USE_MALLOC
endchoice

config MBEDTLS_DYNAMIC_BUFFER
    bool
    depends on !IDF_TARGET_LINUX && !MBEDTLS_SSL_PROTO_DTLS && !MBEDTLS_SSL_VARIABLE_BUFFER_LENGTH
    default y if SPIRAM_USE_MALLOC

choice MBEDTLS_COMPILER_OPTIMIZATION
    default MBEDTLS_COMPILER_OPTIMIZATION_PERF if SPIRAM_USE_MALLOC
endchoice

config MBEDTLS_ECP_RESTARTABLE
    bool
    depends on MBEDTLS_ECP_C
    default y

config SPIRAM_TRY_ALLOCATE_WIFI_LWIP
    bool
    default y if SPIRAM_USE_MALLOC

config MQTT_BUFFERS_ON_EXTERNAL_MEMORY
    bool
    depends on SPIRAM
    default y if SPIRAM_USE_MALLOC

config MQTT_TASK_STACK_ON_EXTERNAL_MEMORY
    bool
    depends on SPIRAM && (FREERTOS_TASK_CREATE_ALLOW_EXT_MEM || SPIRAM_ALLOW_STACK_EXTERNAL_MEMORY)
    default y if SPIRAM_USE_MALLOC

config MQTT_TASK_CORE_SELECTION_ENABLED
    bool
    default y

choice MQTT_TASK_CORE_SELECTION
    default MQTT_USE_CORE_0
endchoice

choice BT_NIMBLE_MEM_ALLOC_MODE
    default BT_NIMBLE_MEM_ALLOC_MODE_EXTERNAL if SPIRAM_USE_MALLOC
endchoice

config BT_ALLOCATION_FROM_SPIRAM_FIRST
    bool
    depends on BT_BLUEDROID_ENABLED
    default y if SPIRAM_USE_MALLOC

config BT_CTRL_ALLOW_MALLOC_FROM_SPIRAM
    bool
    depends on BT_CONTROLLER_ENABLED && IDF_TARGET_ESP32S31
    default y if SPIRAM_USE_MALLOC

config BT_BLE_DYNAMIC_ENV_MEMORY
    bool
    depends on BT_BLUEDROID_ENABLED
    default y if SPIRAM_USE_MALLOC

config BT_BLUEDROID_TASK_STACK_IN_EXT_MEM
    bool
    depends on BT_BLUEDROID_ENABLED && SPIRAM && FREERTOS_TASK_CREATE_ALLOW_EXT_MEM
    default y if SPIRAM_USE_MALLOC

config BT_BLUEDROID_BTU_TASK_STACK_IN_EXT_MEM
    bool
    depends on BT_BLUEDROID_ENABLED && SPIRAM && FREERTOS_TASK_CREATE_ALLOW_EXT_MEM
    default y if SPIRAM_USE_MALLOC

config BT_BLUEDROID_HCI_TASK_STACK_IN_EXT_MEM
    bool
    depends on BT_BLUEDROID_ENABLED && SPIRAM && FREERTOS_TASK_CREATE_ALLOW_EXT_MEM
    default y if SPIRAM_USE_MALLOC

config BT_LE_MAX_CONNECTIONS
    int
    depends on BT_CONTROLLER_ENABLED && !BT_NIMBLE_ENABLED
    default 1

config BT_LE_CONN_RESERVED_MEMORY_COUNT
    int
    depends on BT_CONTROLLER_ENABLED && !BT_NIMBLE_ENABLED
    default 1

config BT_NIMBLE_MAX_CONNECTIONS
    int
    depends on BT_NIMBLE_ENABLED
    default 2

config BT_CTRL_BLE_MAX_ACT
    int
    depends on BT_CONTROLLER_ENABLED && IDF_TARGET_ESP32S3
    default 4

config ESP_COEX_SW_COEXIST_ENABLE
    bool
    depends on (ESP_WIFI_ENABLED && BT_ENABLED) || (ESP_WIFI_ENABLED && IEEE802154_ENABLED) || (IEEE802154_ENABLED && BT_ENABLED)
    default y if BT_ENABLED

config ESP_WIFI_EXTRA_IRAM_OPT
    bool
    default n if SPIRAM_USE_MALLOC

config ESP_WIFI_SLP_IRAM_OPT
    bool
    default n if SPIRAM_USE_MALLOC

choice LWIP_TCPIP_TASK_AFFINITY
    default LWIP_TCPIP_TASK_AFFINITY_CPU0
endchoice

choice ESP_WIFI_TASK_CORE_ID
    default ESP_WIFI_TASK_PINNED_TO_CORE_0
endchoice

config LWIP_MAX_SOCKETS
    int
    default 12

# Keep ingress capacity at least as large as the opted-in 24-frame window.
# SDK UDP admission discards datagrams before application counters when full.
config LWIP_UDP_RECVMBOX_SIZE
    int
    default 24 if LUNAROS_NETWORK_REALTIME_UDP

config LWIP_TCPIP_RECVMBOX_SIZE
    int
    default 32 if LUNAROS_NETWORK_REALTIME_UDP
    default 16

config LWIP_MAX_ACTIVE_TCP
    int
    default 10

config LWIP_MAX_LISTENING_TCP
    int
    default 6

config LWIP_MAX_UDP_PCBS
    int
    default 6

config LWIP_DHCPS_MAX_STATION_NUM
    int
    default 2

config LWIP_TCP_OOSEQ_MAX_PBUFS
    int
    default 4
config MBEDTLS_HARDWARE_AES
    bool
    default n if !LUNAROS_NETWORK_HARDWARE_AES
```
