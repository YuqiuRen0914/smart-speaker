// Generated by tools/assets/generate-link-machine.mjs.
#pragma once
inline constexpr const char kLinkMachinePython[] = R"lunarpython(# Functional lesson I/O contract. No CPU, analog ADC error or bus waveform model.
time.sleep_us=lambda us:_device(1,us/1000)
time.ticks_us=lambda:int(_device(125))&((1<<30)-1)
class _CircuitPin:
    IN=0
    OUT=1
    PULL_UP=1
    PULL_DOWN=2
    def __init__(self, id, mode=0, pull=None, *, value=None):
        self.id=int(id)
        self.init(mode,pull,value=value)
    def init(self, mode=0, pull=None, *, value=None):
        _device(100,self.id,int(mode),int(pull or 0),int(value or 0))
    def value(self, value=None):
        return int(_device(101,self.id) if value is None else _device(102,self.id,int(bool(value))))
    def on(self): self.value(1)
    def off(self): self.value(0)
    def __call__(self, value=None): return self.value(value)
class _CircuitADC:
    ATTN_0DB=0
    ATTN_2_5DB=1
    ATTN_6DB=2
    ATTN_11DB=3
    WIDTH_12BIT=12
    def __init__(self, pin, *, atten=3): self.id=pin.id if hasattr(pin,'id') else int(pin)
    def read_u16(self): return int(_device(103,self.id))
    def read(self): return self.read_u16()*4095//65535
    def read_uv(self): return int(_device(104,self.id))
    def atten(self, value): pass
    def width(self, value):
        if value != 12: raise ValueError('Only 12 bit ADC is supported')
class _CircuitPWM:
    def __init__(self, pin, freq=1000, duty_u16=0, duty=None):
        self.id=pin.id if hasattr(pin,'id') else int(pin)
        self.frequency=int(freq)
        self.level=int(duty*65535//1023 if duty is not None else duty_u16)
        self._write()
    def _write(self): _device(105,self.id,self.frequency,self.level/65535)
    def freq(self,value=None):
        if value is not None: self.frequency=int(value); self._write()
        return self.frequency
    def duty_u16(self,value=None):
        if value is not None: self.level=int(value); self._write()
        return self.level
    def duty(self,value=None):
        if value is not None: self.duty_u16(int(value)*65535//1023)
        return self.level*1023//65535
    def duty_ns(self,value=None):
        if value is not None: self.duty_u16(int(value)*self.frequency*65535//1000000000)
        return self.level*1000000000//(65535*self.frequency)
    def deinit(self): _device(106,self.id)
machine.Pin=_CircuitPin
machine.ADC=_CircuitADC
machine.PWM=_CircuitPWM
class _CircuitI2S:
    TX=0
    RX=1
    MONO=0
    STEREO=1
    def __init__(self, id, *, sck, ws, sd, mode, bits, format, rate, ibuf=4096):
        if mode not in (self.TX,self.RX) or bits not in (16,32) or format not in (self.MONO,self.STEREO): raise ValueError('Unsupported I2S format')
        if ibuf < 1 or ibuf > 32768: raise ValueError('I2S buffer must be 1..32768 bytes')
        self.bits=bits
        self.channels=1 if format==self.MONO else 2
        self.mode=mode
        self.rate=int(rate)
        self.capacity=min(8192,max(1,ibuf//(bits//8*self.channels)))
        self.handle=int(_device(120,sck.id if hasattr(sck,'id') else int(sck),ws.id if hasattr(ws,'id') else int(ws),sd.id if hasattr(sd,'id') else int(sd),self.rate,int(mode==self.TX)))
    def _frames(self, data):
        stride=self.bits//8*self.channels
        if len(data)>32768 or len(data)%stride: raise ValueError('I2S buffer must contain complete frames and at most 32768 bytes')
        return len(data)//stride
    def write(self, data):
        if self.mode!=self.TX: raise ValueError('I2S is not a transmitter')
        count=self._frames(data)
        if count>8192: raise ValueError('I2S write exceeds 8192 frames')
        waiting=int(_device(123,self.handle))+count-self.capacity
        if waiting>0: time.sleep_us(waiting*1000000//self.rate+1)
        result=int(_device(121,self.handle,self.bits,self.channels,data))
        return result
    def readinto(self, data):
        if self.mode!=self.RX: raise ValueError('I2S is not a receiver')
        count=self._frames(data)
        if count>8192: raise ValueError('I2S read exceeds 8192 frames')
        stride=self.bits//8
        for index in range(count):
            value=int(_device(122,self.handle,index))
            if self.bits==32: value=value*65536
            for channel in range(self.channels):
                for byte in range(stride): data[(index*self.channels+channel)*stride+byte]=(value>>(byte*8))&255
        time.sleep_us(count*1000000//self.rate)
        return len(data)
    def deinit(self):
        if self.handle:
            _device(124,self.handle)
            self.handle=0
machine.I2S=_CircuitI2S
)lunarpython";
