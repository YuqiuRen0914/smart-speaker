## components_device/media/lunaredu_device_sdcard/Kconfig
```kconfig
menu "LunarEdu sdcard"

config LUNAREDU_DEVICE_ENABLE_TFCARD
    bool "Enable TF card store module"
    default n
    help
        Build the TF card mount/status/control module.

config LUNAREDU_DEVICE_STORAGE_SDCARD
    bool "Enable SD card storage helper"
    default n
    help
        Build the generic SD card mount/status helper backed by the BSP SD
        card resource. This is a narrow device helper for runtime adapters and
        does not register TF card Local API operations by itself.

config LUNAREDU_DEVICE_STORAGE_SDCARD_MOUNT_PATH
    string "SD card mount path"
    depends on LUNAREDU_DEVICE_STORAGE_SDCARD
    default "/sdcard"

endmenu
```

## components_device/sensors/lunaredu_device_mpu6050/Kconfig
```kconfig
menu "LunarEdu mpu6050"

config LUNAREDU_DEVICE_ENABLE_MPU6050
    bool "Enable MPU6050 IMU module"
    default n
    help
        Build the MPU6050 IMU module and its Local API operations.

endmenu
```

## lunaros/Kconfig
```kconfig
menu "Lunaredu LunarOS"

config LUNAREDU_NETWORK_ENABLE_ESPNOW
    bool "Enable LunarOS ESP-NOW transport"
    default n
    help
        Compile ESP-NOW under the shared Network service. Products opt in
        through NetworkPolicy; Wi-Fi lifecycle remains owned by LunarOS.

config LUNAREDU_LUNAROS_MAX_MANAGED_TASKS
    int "Maximum first-party managed tasks"
    range 4 24
    default 20
    help
        Hard upper bound for tasks created through the LunarOS managed-task
        API. ESP-IDF internal tasks such as Wi-Fi, lwIP and HTTPD are outside
        this count.

config LUNAREDU_LUNAROS_MAX_TRANSIENT_TASKS
    int "Maximum transient managed tasks"
    range 0 8
    default 4

config LUNAREDU_LUNAROS_MAX_RESIDENT_TASKS
    int "Maximum resident managed tasks"
    range 1 20
    default 12
    help
        Bounds long-lived first-party tasks separately so feature and
        transient work cannot be crowded out by new resident services.

config LUNAREDU_LUNAROS_MAX_TASKS_PER_OWNER
    int "Maximum managed tasks per owner service"
    range 1 12
    default 6
    help
        Prevents one service from consuming the complete first-party task
        budget. Prefer queues, timers and shared executors after this limit.

config LUNAREDU_LUNAROS_MAX_INTERNAL_TASK_STACK_BYTES
    int "Maximum declared internal task stack bytes"
    range 16384 262144
    default 65536

config LUNAREDU_LUNAROS_MAX_EXTERNAL_TASK_STACK_BYTES
    int "Maximum declared external task stack bytes"
    range 32768 524288
    default 196608

config LUNAREDU_LUNAROS_FOREGROUND_CAPACITY
    int "Maximum registered foreground applications"
    range 1 32
    default 16
    help
        Fixed AppController catalog capacity. Products should keep explicit
        headroom above their registered launcher applications, system
        surfaces and hidden modes.

config LUNAREDU_LUNAROS_APPLICATION_CAPABILITY_CAPACITY
    int "Maximum capabilities per foreground application"
    range 1 16
    default 8

config LUNAREDU_LUNAROS_APPLICATION_SERVICE_CAPACITY
    int "Maximum services per foreground application"
    range 1 8
    default 4

config LUNAREDU_LUNAROS_APPLICATION_RESOURCE_CAPACITY
    int "Maximum resources per foreground application"
    range 1 8
    default 4

config LUNAREDU_LUNAROS_CAPABILITY_CONSUMERS
    int "Maximum app capability dependency declarations"
    range 1 32
    default 16
    help
        Static references to application dependency manifests, independent of
        foreground pages. Registration creates no task or service. Products
        may reduce this bound to their actual number of capability consumers.

config LUNAREDU_LUNAROS_RESOURCE_LEASE_CAPACITY
    int "Maximum simultaneous foreground resource leases"
    range 2 64
    default 32
    help
        Fixed logical resource-lease capacity owned by AppController. Allow
        at least twice the per-application resource capacity so a pending
        foreground can reserve resources before the previous foreground is
        released.

config LUNAREDU_SYSTEM_OTA_BOOTSTRAP_PROJECTS
    string "Factory bootstrap OTA target projects (comma separated)"
    default ""
    help
        Exact ESP application project names, without spaces. Used only while
        running lunaros-bootstrap. Approve targets only after verifying the
        chip, physical hardware, partition layout and required data assets.
        Other products retain same-project, newer-version-only OTA policy.

config LUNAREDU_SYSTEM_OTA_BOOT_CONFIRM_TIMEOUT_MS
    int "OTA boot confirmation timeout (ms)"
    depends on BOOTLOADER_APP_ROLLBACK_ENABLE
    default 30000
    range 5000 300000
    help
        Maximum time a newly booted OTA image may remain pending verification.
        The product entrypoint must call ota_service_confirm_running_image()
        after its critical tasks are healthy. If it does not, LunarOS marks
        the image invalid and asks ESP-IDF to boot the previous image.

config LUNAREDU_NETWORK_ENABLE_PROVISIONING_SERVICE
    bool "Enable LunarOS Wi-Fi provisioning"
    default y

config LUNAREDU_NETWORK_ENABLE_BLE_PROVISIONING
    bool "Enable BLE provisioning transport"
    depends on BT_NIMBLE_ENABLED
    default n
    help
        Advertise the LunarOS provisioning GATT service. The product must
        provide a frame handler which reuses the shared provisioning session.

menu "Desktop interaction subsystem"

config LUNAREDU_DESKTOP_LVGL_RUNTIME
    bool "LVGL physical display runtime"
    default n
    help
        Own LVGL initialization, draw buffering, flush scheduling and touch
        input. Products supply a physical surface callback and select LVGL.
        Can run without the optional local shell for custom product views.

config LUNAREDU_DESKTOP_SHARED_FONTS
    bool "Shared read-only Chinese font partition"
    select LV_FONT_MONTSERRAT_16
    select LV_USE_TINY_TTF
    default n
    help
        Load the fonts partition into PSRAM and provide shared TinyTTF sizes.
        Products select LVGL and initialize it before calling the font runtime.
        This capability can be used without the local desktop shell.

config LUNAREDU_DESKTOP_LOCAL
    bool "Local LVGL display"
    select LV_USE_RLE
    select LV_BIN_DECODER_RAM_LOAD
    select LUNAREDU_DESKTOP_SHARED_FONTS
    default n
    help
        Compile viewport-aware local view hosting. The product supplies the initialized
        display and calls UI updates on its existing LVGL owner executor.

config LUNAREDU_DESKTOP_REMOTE
    bool "Remote semantic presentation for browsers and host tools"
    default n
    help
        Compile the shared document renderer. Does not require LVGL or a
        physical display. Product supplies semantic state and intent handling.

endmenu

config LUNAREDU_DEVICE_WEB
    bool "Device-hosted Web pages"
    default n
    help
        Compile embedded setup and product page support on the existing
        Device API HTTP server. SoftAP/DNS remain owned by Network.

config LUNAREDU_DEVICE_WEB_MAX_PAGE_BYTES
    int "Maximum optional filesystem/product Web page bytes"
    range 4096 131072
    default 65536
    depends on LUNAREDU_DEVICE_WEB


config LUNAREDU_DEVICE_API_HTTP_SERVER_PORT
    int "Local Device API HTTP port"
    default 80
    range 1 65535

config LUNAREDU_DEVICE_API_HTTP_STACK_SIZE
    int "Local Device API HTTP task stack size"
    default 12288
    range 4096 65536

config LUNAREDU_DEVICE_API_HTTP_SERVER_CORE_ID
    int "Local Device API HTTP task core"
    default 1
    range 0 1

config LUNAREDU_DEVICE_API_HTTP_MAX_URI_HANDLERS
    int "Local Device API HTTP max URI handlers"
    default 32
    range 8 128

config LUNAREDU_DEVICE_API_HTTP_MAX_BUFFERED_BODY_BYTES
    int "Local Device API max buffered body bytes"
    default 65536
    range 1024 1048576

config LUNAREDU_DEVICE_API_HTTP_BODY_RECEIVE_TIMEOUTS
    int "Local Device API body receive timeout retries"
    default 3
    range 0 255

endmenu
```

## lunaros/apps/optional/app_music/Kconfig
```kconfig
menu "Music App"
config LUNAROS_MUSIC_EXTERNAL_PLAYER
    bool "Product supplies the Music playback backend"
    default n
    help
        Select exactly one player implementation. The product must bind the
        public PlayerBackend before declaring the desktop. The built-in mono
        player and its decoder are omitted for dedicated stereo/DSP hardware.
endmenu
```

## lunaros/apps/required/app_files/Kconfig
```kconfig
config LUNAROS_DESKTOP_FILE_JPEG
    bool "Enable system Files JPEG preview and silent MJPEG playback"
    depends on LUNAROS_IMAGE_CODEC_ENABLE_JPEG_DECODER
    default n
    help
        Bounded JPEG decoding for the OS file application. Raw contiguous JPEG
        sequences play at 10 fps; this does not enable MP4, WebM or AVI decoding.
```

## lunaros/bsp/Kconfig
```kconfig
menu "LunarOS Board Support"

config LUNAROS_BOARD_ID
    string "Board identity (provided by product)"
    default "unknown"

config LUNAROS_BOARD_NAME
    string "Board display name"
    default "unknown"

config LUNAROS_BOARD_TYPE
    string "Board type"
    default "unknown"

config LUNAROS_BOARD_MODEL
    string "Board model"
    default "unknown"

config LUNAROS_BOARD_REVISION
    string "Hardware revision (unknown until identified)"
    default "unknown"

config LUNAROS_BSP_ENABLE_LEGACY_BASEBOARD
    bool "Enable frozen historical expansion-baseboard wiring"
    default n
    help
        仅用于显式保留现有产品的历史接线。旧底板引脚和资源分组已封存，
        不作为新板型模板，也不表示接线已经通过真机验证。
        新硬件应在产品中维护版本明确的描述，不应选择此项来猜测接线。

choice LUNAREDU_BSP_BOARD_PROFILE
    prompt "板载资源配置"
    default LUNAREDU_BSP_PROFILE_NONE
    help
        只选择资源描述，不决定产品身份。默认不声明任何板级资源。
        历史底板描述必须显式开启；不同芯片和硬件版本不能共用接线假设。

config LUNAREDU_BSP_PROFILE_NONE
    bool "未指定板级资源（新项目默认）"
    help
        不声明历史底板引脚、板载外设或产品身份。资源申请明确返回不支持。

config LUNAREDU_BSP_PROFILE_MINIMAL
    bool "[封存] 旧底板最小装配（无板载外设）"
    depends on LUNAROS_BSP_ENABLE_LEGACY_BASEBOARD
    help
        保留现有产品使用的旧底板资源分组，关闭板载 WS2812、状态灯、camera
        和 TF 卡。它仍有历史底板接线假设，不代表任意新硬件。

config LUNAREDU_BSP_PROFILE_XIAOXING
    bool "小星现有资源描述（GPIO2 电池、固定 I2S）"
    help
        保留小星现有 GPIO2 电池 ADC 和 47/14/1/21 I2S 资源描述。
        不声明旧扩展底板资源。产品身份由产品配置独立提供。

config LUNAREDU_BSP_PROFILE_REMOTE_CONTROLLER
    bool "遥控器资源描述（GPIO2 电池、GPIO43/44 触摸）"
    help
        独立描述现行遥控器的电池 ADC 和触摸 I2C 资源，不声明扩展底板资源。
        产品身份由产品配置提供。

config LUNAREDU_BSP_PROFILE_BASE
    bool "[封存] 旧底板基础装配"
    depends on LUNAROS_BSP_ENABLE_LEGACY_BASEBOARD
    help
        基础装配只带板载 WS2812。只有在底板 GPIO47/GPIO48 I2C 资源
        未使用时，GPIO48 才能用于板载 WS2812。

config LUNAREDU_BSP_PROFILE_CAM_BUNDLE
    bool "[封存] 旧底板摄像头扩展装配"
    depends on LUNAROS_BSP_ENABLE_LEGACY_BASEBOARD
    help
        摄像头扩展装配带 GPIO2 小灯、camera、TF 卡；这些都仍然是可选
        资源，与同一套扩展底板引脚复用。

config LUNAREDU_BSP_PROFILE_REULEAUX_TRIANGLE_V3
    bool "莱洛三角形 V3（ESP32-WROOM-32）"
    help
        coll45 V3 自平衡莱洛三角形硬件，不声明 ESP32-S3 扩展底板资源。
        产品身份由产品配置独立提供。

endchoice

config LUNAREDU_BSP_HAS_ONBOARD_CAMERA
    bool
    default y if LUNAREDU_BSP_PROFILE_CAM_BUNDLE

config LUNAREDU_BSP_HAS_ONBOARD_TFCARD
    bool
    default y if LUNAREDU_BSP_PROFILE_CAM_BUNDLE

endmenu

rsource "boards/general/v2/Kconfig"
```

## lunaros/bsp/boards/general/v2/Kconfig
```kconfig
menu "Experimental general board: hardware v2"
config LUNAROS_BSP_V2_ENABLED
    bool "Enable unmanufactured general board v2 (plan 2)"
    depends on IDF_TARGET_ESP32S3 && LUNAREDU_BSP_PROFILE_NONE
    default n
    help
        在统一bsp组件内启用通用板v2候选后端，仅用于契约验证。
        必须选择未指定现役板级资源，不能同时启用旧板型owner。
        当前接线为候选，未正式打板、烧录或真机验收。

if LUNAROS_BSP_V2_ENABLED
choice LUNAROS_BSP_V2_DISPLAY
    prompt "v2 display assembly"
    default LUNAROS_BSP_V2_DISPLAY_LCD
config LUNAROS_BSP_V2_DISPLAY_NONE
    bool "No display"
config LUNAROS_BSP_V2_DISPLAY_LCD
    bool "SPI LCD"
config LUNAROS_BSP_V2_DISPLAY_QSPI
    bool "QSPI AMOLED"
endchoice

config LUNAROS_BSP_V2_CAMERA
    bool "Declare candidate camera wiring (shares A/B/C)"
    default n
    help
        不启动采集；实际模组、位序、I/O电平与XCLK仍需产品确认。
config LUNAROS_BSP_V2_TFCARD
    bool "Declare shared SPI TF card (CS42)"
    default n
    help
        卡存在时先初始化进SPI模式，再通信屏幕。不承诺热插拔。
config LUNAROS_BSP_V2_I2C_CLOCK_HZ
    int "Common I2C candidate clock (U2 protocol unconfirmed)"
    range 100000 400000
    default 400000
config LUNAROS_BSP_V2_INTERFACE_I2C_CLOCK_HZ
    int "Expansion I2C clock"
    range 100000 400000
    default 400000
endif
endmenu
```

## lunaros/os/configuration/Kconfig.projbuild
```kconfig
config NVS_ALLOCATE_CACHE_IN_SPIRAM
    bool
    depends on SPIRAM && (SPIRAM_USE_CAPS_ALLOC || SPIRAM_USE_MALLOC)
    default y if SPIRAM_USE_MALLOC
```
