## lunaros/os/core/Kconfig
```kconfig
menu "LunarOS core"

config LUNAROS_PRODUCTION_PREPROVISIONED
    bool
    default n
    help
        Production bootloader refuses unprovisioned Secure Boot and Flash Encryption.
        This guard never provisions eFuses; the factory workflow supplies keys first.

config LUNAROS_BOOT_GUARD
    bool "Monitor management progress and rescue repeated application crashes"
    depends on ESP_TASK_WDT_EN
    default n
    help
        Retains a checksummed, image-bound crash budget in RTC memory and
        requests a validated rescue image after three abnormal resets. Adds
        main/network progress watchdog users, with panic enabled, a 60-second
        startup budget and a 15-second budget after a healthy minute. Requires
        the product health owner and OTA rescue callback; does not replace an
        installed bootloader or survive a complete loss of RTC power.

config LUNAREDU_LUNAROS_DEFAULT_TASK_CORE
    int "Default fixed core for application and compute workers"
    range 0 1
    default 0 if FREERTOS_UNICORE
    default 1
    help
        Managed tasks without a placement override use this existing core.
        Explicit placement is validated before allocating or creating a task.
        I/O owners may select core 0 or provide a product-specific fixed core.
        Fixed placement does not replace locking, priorities or retirement.

config LUNAREDU_LUNAROS_CPU_MONITOR
    bool "LunarOS runtime CPU monitoring capability"
    default y
    select FREERTOS_GENERATE_RUN_TIME_STATS
    select FREERTOS_VTASKLIST_INCLUDE_COREID if !FREERTOS_SMP
    help
        Build the OS CPU runtime-counter capability for every product.
        Sampling defaults to off and can be switched at runtime, with an
        independent persistent start-on-boot preference. No worker is created.
        FreeRTOS counter accounting has context-switch overhead even while
        sampling is off. Use the ESP TIMER clock for wall-time percentages.


config LUNAREDU_LUNAROS_FOREGROUND_CAPACITY
    int "Maximum registered foreground applications"
    range 1 32
    default 16
    help
        Core-owned AppController catalog storage, including launcher Apps,
        system surfaces and hidden modes. Not a product defaults override.

config LUNAREDU_LUNAROS_APPLICATION_CAPABILITY_CAPACITY
    int "Maximum capabilities per foreground application"
    range 1 16
    default 8

config LUNAREDU_LUNAROS_APPLICATION_SERVICE_CAPACITY
    int "Maximum services per foreground application"
    range 1 8
    default 4

config LUNAREDU_LUNAROS_APPLICATION_RESOURCE_CAPACITY
    int "Maximum resources per foreground application"
    range 1 8
    default 4

config LUNAREDU_LUNAROS_CAPABILITY_CONSUMERS
    int "Maximum app capability dependency declarations"
    range 1 32
    default 16
    help
        Core-owned references to application dependency manifests, independent
        of foreground pages. Registration creates no task or service.

config LUNAREDU_LUNAROS_RESOURCE_LEASE_CAPACITY
    int "Maximum simultaneous foreground resource leases"
    range 2 64
    default 32
    help
        Fixed logical resource-lease capacity owned by AppController. Allow
        at least twice the per-application resource capacity so a pending
        foreground can reserve resources before the previous foreground is
        released.

endmenu
```

## lunaros/os/runtime/Kconfig
```kconfig
menu "LunarOS runtime"

config LUNAREDU_LUNAROS_MAINTENANCE_IO_CORE
    int "Core for LunarOS blocking network maintenance"
    range 0 1
    default 0
    help
        Runtime owns placement of its resident maintenance I/O task. Keep
        low-priority TLS work on the system/network core so foreground
        rendering on core 1 cannot starve connection setup. Audio and radio
        tasks retain their higher priorities. The core must exist on the target.

config LUNAREDU_LUNAROS_MAINTENANCE_IO_PRIORITY
    int "Priority for LunarOS blocking network maintenance"
    range 0 1
    default 1
    help
        Blocking TLS work must progress above idle during concurrent audio
        and display work. Input, audio and rendering retain higher priority.

endmenu
```

## lunaros/services/optional/service_audio/Kconfig
```kconfig
menu "LunarOS audio"
config LUNAROS_AUDIO_FILE_PLAYER
    bool "Managed streaming file player"
    default n
    help
        One managed decoder worker using the shared AudioFileDecoder. Supports
        native stereo PCM and service-owned background playback independently
        of the foreground display owner.
config LUNAROS_AUDIO_DUAL_I2S
    bool "Independent dual I2S TX output"
    default n
    help
        Parameterized dual-controller output, fixed PCM pool, shared DSP and
        checked drain/shutdown. Board pins and settings namespace are injected.
config LUNAROS_AUDIO_RUNTIME
    bool "Enable PCM audio runtime"
    default y if LUNAREDU_DEVICE_ENABLE_AUDIO
    default n
    help
        Build the shared PCM bridge, buffering and realtime audio runtime.
        Products using a board codec/BSP can enable this without enabling the
        generic LunarEdu I2S hardware device.

config LUNAROS_AUDIO_REFERENCE_SAMPLES
    int "Maximum output reference samples"
    range 256 64000
    default 8000
    help
        Fixed PCM reference ring capacity, allocated only when audio starts.
        Each sample consumes two bytes. 8000 samples represent 500 ms at 16 kHz.
config LUNAROS_AUDIO_REALTIME_OUTPUT_CORE
    int "Realtime PCM output worker core"
    depends on LUNAROS_AUDIO_RUNTIME && LUNAREDU_DEVICE_I2S_AUDIO
    range 0 0 if FREERTOS_UNICORE
    range 0 1
    default 0
    help
        Product execution placement for the existing managed PCM output owner.
        Choose alongside the capture, decoder, network and display task plan.
        Priority, buffering, sample rate and DSP remain independent of affinity.
endmenu
```

## lunaros/services/optional/service_diagnostics/Kconfig
```kconfig
rsource "src/ports/gprof/Kconfig"
rsource "src/ports/insights/Kconfig"

menu "LunarOS diagnostics capture"
config LUNAROS_DIAGNOSTIC_FIELD
    bool "Private diagnostic outbox and authenticated Platform upload"
    depends on LUNAREDU_SYSTEM_DIAGNOSTICS
    default n
    help
        Stores up to six bounded records in Storage's private namespace.
        Upload requires explicit consent for the current Platform binding.
config LUNAROS_DIAGNOSTIC_HEAP
    bool "Official bounded standalone heap tracing"
    depends on LUNAREDU_SYSTEM_DIAGNOSTICS
    default n
    help
        Allocates 256 internal trace records on explicit authorized start.
        Session expiry stops tracing; service shutdown detaches and frees them.
choice LUNAROS_DIAGNOSTIC_INSIGHTS_PROFILE
    prompt "Insights bounded metric set"
    depends on LUNAROS_DIAGNOSTIC_INSIGHTS
    default LUNAROS_DIAGNOSTIC_INSIGHTS_SYSTEM
config LUNAROS_DIAGNOSTIC_INSIGHTS_SYSTEM
    bool "Memory, tasks and optional PCM anomalies"
config LUNAROS_DIAGNOSTIC_INSIGHTS_IO
    bool "Network queue, execution and completion counters"
    help
        Selects eight existing allocation-free Network counters. Does not
        increase the metric store, sampling frequency or worker count.
endchoice
choice LUNAROS_DIAGNOSTIC_TRACE
    prompt "Official trace integration"
    default LUNAROS_DIAGNOSTIC_TRACE_NONE
config LUNAROS_DIAGNOSTIC_TRACE_NONE
    bool "Disabled"
config LUNAROS_DIAGNOSTIC_APPTRACE
    bool "App Trace operation records (JTAG and optional field retention)"
    depends on LUNAREDU_SYSTEM_DIAGNOSTICS && !PM_ENABLE
config LUNAROS_DIAGNOSTIC_SYSTEMVIEW
    bool "SystemView scheduler and operation events (JTAG or field retention)"
    depends on LUNAREDU_SYSTEM_DIAGNOSTICS && !PM_ENABLE
endchoice
config LUNAROS_DIAGNOSTIC_COREDUMP_UART
    bool "ELF core dump on the existing panic console"
    depends on LUNAREDU_SYSTEM_DIAGNOSTICS
    default n
    help
        Does not change partitions or select a rescue image. SDK panic capture
        is independent of the optional service lifecycle. Keep the matching ELF
        and capture the console with IDF Monitor. External RAM is not included.
config LUNAREDU_SYSTEM_DIAGNOSTICS
    bool "System diagnostic operations and sessions"
    default n
config LUNAREDU_LOCAL_DEBUG_SURFACE
    bool "Local log and display debugging"
    default n
config LUNAROS_DIAGNOSTIC_LOG_RECORDS
    int "Retained log/trace records"
    range 16 256
    default 64
config LUNAROS_DIAGNOSTIC_LOG_MESSAGE_BYTES
    int "Bytes per captured log message"
    range 160 512
    default 160
endmenu

config LUNAROS_DIAGNOSTIC_COREDUMP_FLASH
    bool
    depends on LUNAREDU_OTA_FIELD_DIAGNOSTICS_LAYOUT && LUNAROS_DIAGNOSTIC_FIELD
    default y
```

## lunaros/services/optional/service_diagnostics/Kconfig.projbuild
```kconfig
# Diagnostic transport policy belongs to Diagnostics, not individual boards.
choice HEAP_TRACING_DEST
    default HEAP_TRACING_STANDALONE if LUNAROS_DIAGNOSTIC_HEAP
endchoice
config HEAP_TRACING_STACK_DEPTH
    int
    default 4 if LUNAROS_DIAGNOSTIC_HEAP

choice ESP_TRACE_LIBRARY
    default ESP_TRACE_LIB_EXTERNAL if LUNAROS_DIAGNOSTIC_SYSTEMVIEW
    default ESP_TRACE_LIB_NONE
endchoice

choice ESP_TRACE_TRANSPORT
    default ESP_TRACE_TRANSPORT_EXTERNAL if LUNAROS_DIAGNOSTIC_SYSTEMVIEW && LUNAROS_DIAGNOSTIC_FIELD
    default ESP_TRACE_TRANSPORT_APPTRACE if LUNAROS_DIAGNOSTIC_APPTRACE || LUNAROS_DIAGNOSTIC_SYSTEMVIEW
endchoice

choice APPTRACE_DESTINATION
    default APPTRACE_DEST_JTAG if LUNAROS_DIAGNOSTIC_APPTRACE || LUNAROS_DIAGNOSTIC_SYSTEMVIEW
endchoice

choice ESP_TRACE_TIMESTAMP_SOURCE
    default ESP_TRACE_TS_SOURCE_ESP_TIMER if LUNAROS_DIAGNOSTIC_SYSTEMVIEW
endchoice

config SEGGER_SYSVIEW_MAX_TASKS
    int
    default 64 if LUNAROS_DIAGNOSTIC_SYSTEMVIEW

config SEGGER_SYSVIEW_BUF_WAIT_TMO
    int
    default 0 if LUNAROS_DIAGNOSTIC_SYSTEMVIEW

config APPTRACE_LOCK_ENABLE
    bool
    default y if LUNAROS_DIAGNOSTIC_APPTRACE || LUNAROS_DIAGNOSTIC_SYSTEMVIEW

config APPTRACE_ONPANIC_HOST_FLUSH_TMO
    int
    default 100 if LUNAROS_DIAGNOSTIC_APPTRACE || LUNAROS_DIAGNOSTIC_SYSTEMVIEW

choice ESP_COREDUMP_TO_FLASH_OR_UART
    default ESP_COREDUMP_ENABLE_TO_FLASH if LUNAROS_DIAGNOSTIC_COREDUMP_FLASH
    default ESP_COREDUMP_ENABLE_TO_UART if LUNAROS_DIAGNOSTIC_COREDUMP_UART || LUNAROS_DIAGNOSTIC_COREDUMP_FLASH
endchoice

config ESP_COREDUMP_STACK_SIZE
    int
    default 2048 if LUNAROS_DIAGNOSTIC_COREDUMP_UART || LUNAROS_DIAGNOSTIC_COREDUMP_FLASH

config ESP_COREDUMP_LOGS
    bool
    default n if LUNAROS_DIAGNOSTIC_COREDUMP_UART || LUNAROS_DIAGNOSTIC_COREDUMP_FLASH

config ESP_COREDUMP_CAPTURE_DRAM
    bool
    default n if LUNAROS_DIAGNOSTIC_COREDUMP_UART || LUNAROS_DIAGNOSTIC_COREDUMP_FLASH

# APP_RETRIEVE_LEN_ELF_SHA is assigned by the shared diagnostic profiles.
# The SDK declares its unconditional default earlier, so a later Kconfig
# default here cannot select the full identity required by Flash Core Dump.
```

## lunaros/services/optional/service_diagnostics/src/ports/gprof/Kconfig
```kconfig
config GPROF_ENABLE
    bool "Official single-owner function profiling"
    default n
config GPROF_COMPONENTS
    string "Components instrumented by the diagnostic GProf policy"
    default "service_diagnostics"
    depends on GPROF_ENABLE
```

## lunaros/services/optional/service_diagnostics/src/ports/insights/Kconfig
```kconfig
config LUNAROS_DIAGNOSTIC_INSIGHTS
    bool "ESP Insights metrics through LunarLink"
    depends on LUNAROS_DIAGNOSTIC_FIELD
    default y

config DIAG_ENABLE_METRICS
    bool
    default y if LUNAROS_DIAGNOSTIC_INSIGHTS

config DIAG_METRICS_MAX_COUNT
    int
    default 8

config DIAG_DATA_STORE_RAM
    bool
    default y if LUNAROS_DIAGNOSTIC_INSIGHTS

config RAM_STORE_DATA_SIZE
    int
    default 2048

config RAM_STORE_CRITICAL_DATA_SIZE
    int
    default 512

config DIAG_DATA_STORE_REPORTING_WATERMARK_PERCENT
    int
    default 80

config DIAG_LOG_MSG_ARG_FORMAT_STRING
    bool
    default y if LUNAROS_DIAGNOSTIC_INSIGHTS

config DIAG_LOG_MSG_ARG_MAX_SIZE
    int
    default 64
```
