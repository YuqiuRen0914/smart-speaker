## components/image_codec/Kconfig
```kconfig
menu "LunarOS Image Codec"

config LUNAROS_IMAGE_CODEC_ENABLE_JPEG_DECODER
    bool "Enable JPEG decoder"
    default n
    help
        Enable JPEG-to-RGB565 decoding through esp_new_jpeg, without camera drivers.
        Disable this for apps that feed already-normalized RGB565 frames.

config LUNAROS_IMAGE_CODEC_ENABLE_HARDWARE_JPEG_ENCODER
    bool "Enable hardware JPEG encoder"
    depends on SOC_JPEG_ENCODE_SUPPORTED
    default n
    help
        Prefer the ESP hardware JPEG encoder when the target supports it.
        The software esp_new_jpeg encoder remains the fallback.

config LUNAROS_IMAGE_CODEC_ALLOW_JPEG_INPUT
    bool "Allow JPEG passthrough input"
    default n
    help
        Allow encode_image_to_jpeg to pass already-JPEG input through instead of
        re-encoding it.

endmenu
```

## components/lunaredu_audio/Kconfig
```kconfig
menu "LunarEdu audio"
config LUNAREDU_AUDIO_REFERENCE_SAMPLES
    int "Maximum output reference samples"
    range 256 64000
    default 8000
    help
        Fixed PCM reference ring capacity, allocated only when audio starts.
        Each sample consumes two bytes. 8000 samples represent 500 ms at 16 kHz.
endmenu
```

## components/lunaredu_bsp/Kconfig
```kconfig
menu "LunarEdu BSP"

choice LUNAREDU_BSP_BOARD_PROFILE
    prompt "板载资源配置"
    default LUNAREDU_BSP_PROFILE_CAM_BUNDLE
    help
        当前 BSP 统一建模为同一套 ESP32-S3-N16R8 核心板，差异只体现在
        板载资源装配 profile 上。

config LUNAREDU_BSP_PROFILE_MINIMAL
    bool "最小装配（无板载外设）"
    help
        最小装配不声明板载 WS2812、状态灯、camera 或 TF 卡资源，适合只使用
        外接按键、屏幕和无线能力的独立产品。

config LUNAREDU_BSP_PROFILE_YUEZAI
    bool "月仔 V1（ESP32-S3-N4R2）"
    help
        月仔桌面机器人。资源声明与最小装配一致，但向 Local Device API
        提供 yuezai-202608-v1 / yuezai 的稳定硬件身份。

config LUNAREDU_BSP_PROFILE_BASE
    bool "基础装配（普通核心板）"
    help
        基础装配只带板载 WS2812。只有在底板 GPIO47/GPIO48 I2C 资源
        未使用时，GPIO48 才能用于板载 WS2812。

config LUNAREDU_BSP_PROFILE_CAM_BUNDLE
    bool "摄像头扩展装配"
    help
        摄像头扩展装配带 GPIO2 小灯、camera、TF 卡；这些都仍然是可选
        资源，与同一套扩展底板引脚复用。

config LUNAREDU_BSP_PROFILE_REULEAUX_TRIANGLE_V3
    bool "莱洛三角形 V3（ESP32-WROOM-32）"
    help
        coll45 V3 自平衡莱洛三角形硬件。只提供正确的设备身份，
        不声明 ESP32-S3 扩展底板资源。

endchoice

config LUNAREDU_BSP_HAS_ONBOARD_WS2812
    bool
    default y if LUNAREDU_BSP_PROFILE_BASE

config LUNAREDU_BSP_HAS_ONBOARD_STATUS_LED
    bool
    default y if LUNAREDU_BSP_PROFILE_CAM_BUNDLE

config LUNAREDU_BSP_HAS_ONBOARD_CAMERA
    bool
    default y if LUNAREDU_BSP_PROFILE_CAM_BUNDLE

config LUNAREDU_BSP_HAS_ONBOARD_TFCARD
    bool
    default y if LUNAREDU_BSP_PROFILE_CAM_BUNDLE

endmenu
```

## components/micropython/Kconfig
```kconfig
menu "MicroPython engine"

config LUNAREDU_MICROPYTHON_VM_YIELD_BRANCH_INTERVAL
    int "VM branch interval before yielding"
    default 128
    range 16 4096
    help
        Invoke the host yield callback after this many bytecode branches.
        The engine itself does not create or manage an execution task.

endmenu
```

## components/wamr/Kconfig.projbuild
```kconfig
menu "LunarOS Wasm runtime"
config LUNAROS_WAMR_AOT
    bool "Enable signed ESP32-S3 AOT applications"
    depends on IDF_TARGET_ESP32S3 && SPIRAM
    default n
    help
        Opt-in pending board acceptance. Uses the pinned WAMR loader, PSRAM
        executable mapping, software bounds checks and OS checkpoint budgets.
config WAMR_AOT_CODE_IN_PSRAM
    bool
    default y if LUNAROS_WAMR_AOT
config LUNAROS_AOT_SIGNER_ID
    string "Trusted AOT publisher key id"
    depends on LUNAROS_WAMR_AOT
    default ""
config LUNAROS_AOT_PUBLIC_KEY
    string "Trusted P-256 public key (130 lowercase hex characters, uncompressed)"
    depends on LUNAROS_WAMR_AOT
    default ""
    help
        Public verification key only. Never put a signing private key in firmware.
        An empty or invalid key disables AOT catalog selection and installation.
endmenu
```

## components_device/display/lunaredu_device_spi_lcd/Kconfig
```kconfig
menu "LunarEdu spi_lcd"

config LUNAREDU_DEVICE_DISPLAY_SPI_LCD
    bool "Enable SPI LCD display helper"
    default n
    help
        Build the generic SPI LCD panel helper. It owns display pin/resource
        setup and returns ESP-IDF LCD panel handles for app/runtime UI code.

choice LUNAREDU_DEVICE_DISPLAY_SPI_LCD_CONTROLLER
    prompt "SPI LCD controller"
    depends on LUNAREDU_DEVICE_DISPLAY_SPI_LCD
    default LUNAREDU_DEVICE_DISPLAY_SPI_LCD_ST7789

    config LUNAREDU_DEVICE_DISPLAY_SPI_LCD_ST7789
        bool "ST7789-compatible"
    config LUNAREDU_DEVICE_DISPLAY_SPI_LCD_ILI9488
        bool "ILI9488-compatible"
endchoice

config LUNAREDU_DEVICE_DISPLAY_SPI_LCD_ILI9488_PIPELINE_ROWS
    int "ILI9488 RGB666 DMA pipeline rows per buffer"
    depends on LUNAREDU_DEVICE_DISPLAY_SPI_LCD && LUNAREDU_DEVICE_DISPLAY_SPI_LCD_ILI9488
    range 2 16
    default 4
    help
        Number of native 480-pixel rows converted into each internal DMA
        buffer. Two buffers are retained so conversion can overlap SPI DMA.
        Larger values reduce transaction overhead, but consume internal DMA
        SRAM permanently; keep this conservative on Wi-Fi/assistant products.

choice LUNAREDU_DEVICE_DISPLAY_SPI_LCD_HOST
    prompt "SPI LCD host"
    depends on LUNAREDU_DEVICE_DISPLAY_SPI_LCD
    default LUNAREDU_DEVICE_DISPLAY_SPI_LCD_SPI2_HOST

    config LUNAREDU_DEVICE_DISPLAY_SPI_LCD_SPI2_HOST
        bool "SPI2 host"
    config LUNAREDU_DEVICE_DISPLAY_SPI_LCD_SPI3_HOST
        bool "SPI3 host"
endchoice

config LUNAREDU_DEVICE_DISPLAY_SPI_LCD_3WIRE_9BIT
    bool "Use three-wire 9-bit command/data framing"
    depends on LUNAREDU_DEVICE_DISPLAY_SPI_LCD
    default n
    help
        Select this for panels where the D/C value is transferred as the
        ninth bit before every command, parameter and pixel byte. A separate
        D/C GPIO is not used in this mode.

choice LUNAREDU_DEVICE_DISPLAY_SPI_LCD_3WIRE_DMA_CHUNK
    prompt "Three-wire pixel source bytes per DMA chunk"
    depends on LUNAREDU_DEVICE_DISPLAY_SPI_LCD_3WIRE_9BIT
    default LUNAREDU_DEVICE_DISPLAY_SPI_LCD_3WIRE_DMA_CHUNK_8K
    help
        Two internal DMA packing buffers are reserved in queued mode.
        Smaller chunks save internal SRAM but increase SPI transactions.

    config LUNAREDU_DEVICE_DISPLAY_SPI_LCD_3WIRE_DMA_CHUNK_2K
        bool "2048 source bytes (2304 packed bytes per buffer)"
    config LUNAREDU_DEVICE_DISPLAY_SPI_LCD_3WIRE_DMA_CHUNK_4K
        bool "4096 source bytes (4608 packed bytes per buffer)"
    config LUNAREDU_DEVICE_DISPLAY_SPI_LCD_3WIRE_DMA_CHUNK_8K
        bool "8192 source bytes (9216 packed bytes per buffer)"
endchoice

config LUNAREDU_DEVICE_DISPLAY_SPI_LCD_MOSI
    int "SPI LCD MOSI GPIO"
    depends on LUNAREDU_DEVICE_DISPLAY_SPI_LCD
    range -1 48
    default 21

config LUNAREDU_DEVICE_DISPLAY_SPI_LCD_SCLK
    int "SPI LCD SCLK GPIO"
    depends on LUNAREDU_DEVICE_DISPLAY_SPI_LCD
    range -1 48
    default 14

config LUNAREDU_DEVICE_DISPLAY_SPI_LCD_MISO
    int "SPI LCD MISO GPIO"
    depends on LUNAREDU_DEVICE_DISPLAY_SPI_LCD
    range -1 48
    default -1

config LUNAREDU_DEVICE_DISPLAY_SPI_LCD_CS
    int "SPI LCD CS GPIO"
    depends on LUNAREDU_DEVICE_DISPLAY_SPI_LCD
    range -1 48
    default 42

config LUNAREDU_DEVICE_DISPLAY_SPI_LCD_DC
    int "SPI LCD D/C GPIO"
    depends on LUNAREDU_DEVICE_DISPLAY_SPI_LCD && !LUNAREDU_DEVICE_DISPLAY_SPI_LCD_3WIRE_9BIT
    range -1 48
    default 41

config LUNAREDU_DEVICE_DISPLAY_SPI_LCD_RESET
    int "SPI LCD reset GPIO"
    depends on LUNAREDU_DEVICE_DISPLAY_SPI_LCD
    range -1 48
    default -1

config LUNAREDU_DEVICE_DISPLAY_SPI_LCD_BACKLIGHT
    int "SPI LCD backlight GPIO"
    depends on LUNAREDU_DEVICE_DISPLAY_SPI_LCD
    range -1 48
    default -1

config LUNAREDU_DEVICE_DISPLAY_SPI_LCD_BACKLIGHT_INVERT
    bool "SPI LCD backlight output inverted"
    depends on LUNAREDU_DEVICE_DISPLAY_SPI_LCD
    default n

config LUNAREDU_DEVICE_DISPLAY_SPI_LCD_PIXEL_CLOCK_HZ
    int "SPI LCD pixel clock in Hz"
    depends on LUNAREDU_DEVICE_DISPLAY_SPI_LCD
    range 1000000 80000000
    default 20000000

config LUNAREDU_DEVICE_DISPLAY_SPI_LCD_SPI_MODE
    int "SPI LCD SPI mode"
    depends on LUNAREDU_DEVICE_DISPLAY_SPI_LCD
    range 0 3
    default 0

config LUNAREDU_DEVICE_DISPLAY_SPI_LCD_WIDTH
    int "SPI LCD width"
    depends on LUNAREDU_DEVICE_DISPLAY_SPI_LCD
    range 1 4096
    default 160

config LUNAREDU_DEVICE_DISPLAY_SPI_LCD_HEIGHT
    int "SPI LCD height"
    depends on LUNAREDU_DEVICE_DISPLAY_SPI_LCD
    range 1 4096
    default 80

config LUNAREDU_DEVICE_DISPLAY_SPI_LCD_OFFSET_X
    int "SPI LCD X offset"
    depends on LUNAREDU_DEVICE_DISPLAY_SPI_LCD
    range 0 4096
    default 1

config LUNAREDU_DEVICE_DISPLAY_SPI_LCD_OFFSET_Y
    int "SPI LCD Y offset"
    depends on LUNAREDU_DEVICE_DISPLAY_SPI_LCD
    range 0 4096
    default 26

config LUNAREDU_DEVICE_DISPLAY_SPI_LCD_MIRROR_X
    bool "SPI LCD mirror X"
    depends on LUNAREDU_DEVICE_DISPLAY_SPI_LCD
    default n

config LUNAREDU_DEVICE_DISPLAY_SPI_LCD_MIRROR_Y
    bool "SPI LCD mirror Y"
    depends on LUNAREDU_DEVICE_DISPLAY_SPI_LCD
    default n

config LUNAREDU_DEVICE_DISPLAY_SPI_LCD_SWAP_XY
    bool "SPI LCD swap X/Y"
    depends on LUNAREDU_DEVICE_DISPLAY_SPI_LCD
    default n

config LUNAREDU_DEVICE_DISPLAY_SPI_LCD_INVERT_COLOR
    bool "SPI LCD invert colors"
    depends on LUNAREDU_DEVICE_DISPLAY_SPI_LCD
    default y

choice LUNAREDU_DEVICE_DISPLAY_SPI_LCD_RGB_ORDER
    prompt "SPI LCD RGB element order"
    depends on LUNAREDU_DEVICE_DISPLAY_SPI_LCD
    default LUNAREDU_DEVICE_DISPLAY_SPI_LCD_RGB_ORDER_RGB

    config LUNAREDU_DEVICE_DISPLAY_SPI_LCD_RGB_ORDER_RGB
        bool "RGB"
    config LUNAREDU_DEVICE_DISPLAY_SPI_LCD_RGB_ORDER_BGR
        bool "BGR"
endchoice

config LUNAREDU_DEVICE_DISPLAY_SPI_LCD_CLAIM_BSP_SPI
    bool "Claim BSP expansion SPI resource"
    depends on LUNAREDU_DEVICE_DISPLAY_SPI_LCD
    default y

endmenu
```

## components_device/input/lunaredu_device_gpio_button/Kconfig
```kconfig
menu "LunarEdu gpio_button"

config LUNAREDU_DEVICE_INPUT_PRIMARY_BUTTON
    bool "Enable primary GPIO button"
    default n
    help
        Build the generic GPIO button helper and expose a primary button
        configuration. Button semantics belong to the app or runtime adapter.

config LUNAREDU_DEVICE_INPUT_PRIMARY_BUTTON_GPIO
    int "Primary button GPIO"
    depends on LUNAREDU_DEVICE_INPUT_PRIMARY_BUTTON
    range 0 48
    default 0

config LUNAREDU_DEVICE_INPUT_PRIMARY_BUTTON_ACTIVE_HIGH
    bool "Primary button active high"
    depends on LUNAREDU_DEVICE_INPUT_PRIMARY_BUTTON
    default n

config LUNAREDU_DEVICE_INPUT_PRIMARY_BUTTON_LONG_PRESS_MS
    int "Primary button long press time in ms"
    depends on LUNAREDU_DEVICE_INPUT_PRIMARY_BUTTON
    range 0 60000
    default 2000

config LUNAREDU_DEVICE_INPUT_PRIMARY_BUTTON_SHORT_PRESS_MS
    int "Primary button short press time in ms"
    depends on LUNAREDU_DEVICE_INPUT_PRIMARY_BUTTON
    range 0 60000
    default 0

config LUNAREDU_DEVICE_INPUT_PRIMARY_BUTTON_POWER_SAVE
    bool "Enable primary button power-save wake support"
    depends on LUNAREDU_DEVICE_INPUT_PRIMARY_BUTTON
    default n

config LUNAREDU_DEVICE_INPUT_PTT_BUTTON
    bool "Enable dedicated press-to-talk GPIO button"
    default n

config LUNAREDU_DEVICE_INPUT_PTT_BUTTON_GPIO
    int "Press-to-talk button GPIO"
    depends on LUNAREDU_DEVICE_INPUT_PTT_BUTTON
    range 0 48
    default 0

config LUNAREDU_DEVICE_INPUT_PTT_BUTTON_ACTIVE_HIGH
    bool "Press-to-talk button active high"
    depends on LUNAREDU_DEVICE_INPUT_PTT_BUTTON
    default n

config LUNAREDU_DEVICE_INPUT_PTT_BUTTON_POWER_SAVE
    bool "Enable press-to-talk button power-save wake support"
    depends on LUNAREDU_DEVICE_INPUT_PTT_BUTTON
    default n

endmenu
```

## components_device/media/lunaredu_device_i2s_audio/Kconfig
```kconfig
menu "LunarEdu i2s_audio"

config LUNAREDU_DEVICE_I2S_AUDIO
    bool "Enable I2S audio hardware helper"
    default n
    help
        Build the generic I2S microphone/speaker topology and pin helper.
        This only owns board wiring validation and BSP resource reservation;
        codec/runtime ownership belongs to the app or assistant adapter.

choice LUNAREDU_DEVICE_I2S_AUDIO_TOPOLOGY
    prompt "I2S audio topology"
    depends on LUNAREDU_DEVICE_I2S_AUDIO
    default LUNAREDU_DEVICE_I2S_AUDIO_DUPLEX

    config LUNAREDU_DEVICE_I2S_AUDIO_DUPLEX
        bool "Duplex shared BCLK/WS"
    config LUNAREDU_DEVICE_I2S_AUDIO_SIMPLEX
        bool "Simplex separated speaker/microphone clocks"
endchoice

config LUNAREDU_DEVICE_I2S_AUDIO_INPUT_SAMPLE_RATE
    int "Input sample rate"
    depends on LUNAREDU_DEVICE_I2S_AUDIO
    range 8000 48000
    default 24000

config LUNAREDU_DEVICE_I2S_AUDIO_OUTPUT_SAMPLE_RATE
    int "Output sample rate"
    depends on LUNAREDU_DEVICE_I2S_AUDIO
    range 8000 48000
    default 24000

config LUNAREDU_DEVICE_I2S_AUDIO_BCLK
    int "Duplex BCLK GPIO"
    depends on LUNAREDU_DEVICE_I2S_AUDIO
    range -1 48
    default -1

config LUNAREDU_DEVICE_I2S_AUDIO_WS
    int "Duplex WS GPIO"
    depends on LUNAREDU_DEVICE_I2S_AUDIO
    range -1 48
    default -1

config LUNAREDU_DEVICE_I2S_AUDIO_DOUT
    int "Duplex speaker DOUT GPIO"
    depends on LUNAREDU_DEVICE_I2S_AUDIO
    range -1 48
    default -1

config LUNAREDU_DEVICE_I2S_AUDIO_DIN
    int "Duplex microphone DIN GPIO"
    depends on LUNAREDU_DEVICE_I2S_AUDIO
    range -1 48
    default -1

config LUNAREDU_DEVICE_I2S_AUDIO_SPK_BCLK
    int "Speaker BCLK GPIO"
    depends on LUNAREDU_DEVICE_I2S_AUDIO
    range -1 48
    default -1

config LUNAREDU_DEVICE_I2S_AUDIO_SPK_WS
    int "Speaker WS GPIO"
    depends on LUNAREDU_DEVICE_I2S_AUDIO
    range -1 48
    default -1

config LUNAREDU_DEVICE_I2S_AUDIO_SPK_DOUT
    int "Speaker DOUT GPIO"
    depends on LUNAREDU_DEVICE_I2S_AUDIO
    range -1 48
    default -1

config LUNAREDU_DEVICE_I2S_AUDIO_MIC_SCK
    int "Microphone SCK GPIO"
    depends on LUNAREDU_DEVICE_I2S_AUDIO
    range -1 48
    default -1

config LUNAREDU_DEVICE_I2S_AUDIO_MIC_WS
    int "Microphone WS GPIO"
    depends on LUNAREDU_DEVICE_I2S_AUDIO
    range -1 48
    default -1

config LUNAREDU_DEVICE_I2S_AUDIO_MIC_DIN
    int "Microphone DIN GPIO"
    depends on LUNAREDU_DEVICE_I2S_AUDIO
    range -1 48
    default -1

choice LUNAREDU_DEVICE_I2S_AUDIO_MIC_SLOT
    prompt "Microphone I2S slot"
    depends on LUNAREDU_DEVICE_I2S_AUDIO
    default LUNAREDU_DEVICE_I2S_AUDIO_MIC_SLOT_LEFT
    help
        Select which I2S time slot carries the microphone sample. INMP441
        boards expose an L/R pin; if that pin selects Right while firmware
        reads Left, captured audio will look like silence.

    config LUNAREDU_DEVICE_I2S_AUDIO_MIC_SLOT_LEFT
        bool "Left"
    config LUNAREDU_DEVICE_I2S_AUDIO_MIC_SLOT_RIGHT
        bool "Right"
    config LUNAREDU_DEVICE_I2S_AUDIO_MIC_SLOT_BOTH
        bool "Both"
endchoice

config LUNAREDU_DEVICE_ENABLE_AUDIO
    bool "Enable I2S PCM audio device"
    default n
    select LUNAREDU_DEVICE_I2S_AUDIO
    help
        Build the optional I2S PCM audio adapter. Apps that do not use audio
        should leave this disabled to avoid allocating I2S channels.
        Speech processing and wake-word models are owned by Pet.
        This selects the I2S audio hardware helper so the PCM device can be
        configured from the same microphone/speaker Kconfig values used by
        assistant adapters.

endmenu
```
